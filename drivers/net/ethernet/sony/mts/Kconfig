## drivers/net/ethernet/sony/mts/Kconfig
```kconfig
# SPDX-License-Identifier: GPL-2.0-only
config MTS
	tristate "PlayStation 4 Baikal Gigabit Ethernet"
	depends on PCI && X86_PS4
	help
	  Driver for the Sony mts Gigabit Ethernet controller (104d:90d8)
	  in the Baikal southbridge of the PlayStation 4.

	  To compile this driver as a module, choose M here. The module
	  will be called mts.
```
